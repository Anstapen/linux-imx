// SPDX-License-Identifier: (GPL-2.0+ OR MIT)
/*
 * Copyright 2024 NXP
 */

#include "imx93-11x11-frdm-dsi.dts"

&iomuxc {
    pinctrl_lpi2c4: lpi2c4grp {
		fsl,pins = <
			MX93_PAD_GPIO_IO03__LPI2C4_SCL			0x40000b9e
			MX93_PAD_GPIO_IO02__LPI2C4_SDA			0x40000b9e
		>;
	};
};


&lpi2c4 {
 #address-cells = <1>;
 #size-cells = <0>;
 clock-frequency = <400000>;
 pinctrl-names = "default", "sleep";
 pinctrl-0 = <&pinctrl_lpi2c4>;
 pinctrl-1 = <&pinctrl_lpi2c4>;
 status = "okay";

 lp55231: lp55231@32 {
		compatible = "ti,lp55231";
		reg = <0x32>;
};

};

